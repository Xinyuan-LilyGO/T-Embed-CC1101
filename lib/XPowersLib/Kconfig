## lib/XPowersLib/Kconfig
```kconfig
menu "XPowersLib Configuration"

    choice PMU_Type
        prompt "XPowers chip type"
        default XPOWERS_CHIP_AXP2101 if IDF_TARGET_ESP32
        default XPOWERS_CHIP_AXP192
        help
            Defines the default peripheral for xpowers example

        config XPOWERS_CHIP_AXP2101
            bool "Xpowers AXP2101"
        config XPOWERS_CHIP_AXP192
            bool "Xpowers AXP192"
    endchoice

    choice XPowersLib_ESP_IDF_API
        prompt "XPowers library esp-idf api version"
        default XPOWERS_ESP_IDF_NEW_API
        help
            Define API version

        config XPOWERS_ESP_IDF_NEW_API
            bool "Use esp-idf higher version (>= 5.0) API"
        config XPOWERS_ESP_IDF_OLD_API
            bool "Use esp-idf lower version ( < 5.0) API , Compatible with lower versions of esp-idf"
    endchoice

    config I2C_MASTER_PORT_NUM
        int "PMU I2C Port Number"
        default 1
        help
            Port number for I2C Master device.

    config I2C_MASTER_FREQUENCY
        int "Master Frequency"
        default 100000
        help
            I2C Speed of Master device.

    config PMU_I2C_SCL
        int "PMU SCL GPIO Num"
        default 22
        help
            GPIO number for I2C PMU clock line.

    config PMU_I2C_SDA
        int "PMU SDA GPIO Num"
        default 21
        help
            GPIO number for I2C PMU data line.

    config PMU_INTERRUPT_PIN
        int "PMU Interrupt Pin"
        default 35
        help
            PMU interrupt pin.


endmenu
```
